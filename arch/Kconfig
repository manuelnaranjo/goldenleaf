## arch/Kconfig
```kconfig
#
# General architecture dependent options
#

config HAVE_EFFICIENT_UNALIGNED_ACCESS
        bool
        help
          Some architectures are unable to perform unaligned accesses
          without the use of get_unaligned/put_unaligned. Others are
          unable to perform such accesses efficiently (e.g. trap on
          unaligned access and require fixing it up in the exception
          handler.)

          This symbol should be selected by an architecture if it can
          perform unaligned accesses efficiently to allow different
          code paths to be selected for these cases. Some network
          drivers, for example, could opt to not fix up alignment
          problems with received packets if doing so would not help
          much.

          See Documentation/unaligned-memory-access.txt for more
          information on the topic of unaligned memory accesses.

config HAVE_CLK
   default y
   bool
   help
     The <linux/clk.h> calls support software clock gating and
     thus are a key power management tool on many systems.

config HAVE_ARCH_TRACEHOOK
        bool

config HAVE_DMA_ATTRS
        bool

config USE_GENERIC_SMP_HELPERS
        bool

config HAVE_DMA_API_DEBUG
        bool

config HAVE_DEFAULT_NO_SPIN_MUTEXES
        bool

source "kernel/gcov/Kconfig"
```
